## drivers/phy/realtek/Kconfig
```kconfig
#
# Phy drivers for Realtek platforms
#
config PHY_RTK_SATA
	tristate "Realtek SATA PHY driver"
	depends on OF
    depends on ARCH_REALTEK
	select GENERIC_PHY
	help
	  Support for SATA GEN3 PHY on realtek chipsets.
```

## drivers/soc/realtek/common/rpc/Kconfig
```kconfig
config RTK_RPC
	bool "Realtek RPC driver"
	depends on RTK_MEM_REMAP
	depends on ION_RTK
	depends on FB_RTK
	default y
	help
	  Realtek RPC driver with audio CPU
```
